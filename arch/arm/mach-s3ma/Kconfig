## arch/arm/mach-s3ma/Kconfig
```kconfig
config ARCH_S3MA
	bool "Exelis S3MA SoC family" if ARCH_MULTI_V7
	select ARM_AMBA
	select ARM_GIC
	select CACHE_L2X0
	select ARM_TIMER_SP804
	select GPIO_PL061 if GPIOLIB
	select HAVE_ARM_SCU
	select HAVE_ARM_TWD if SMP
```

## drivers/misc/sbt-test/Kconfig
```kconfig
config SBT_TEST
	tristate "SBT test stubs"
	help
	  Test stubs for S3MA bringup.

	  If unsure, say N
```
